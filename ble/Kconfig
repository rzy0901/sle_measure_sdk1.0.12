## ble/Kconfig
```kconfig
#===============================================================================
# @brief    Kconfig file.
# Copyright (c) HiSilicon (Shanghai) Technologies Co., Ltd. 2023-2023. All rights reserved.
#===============================================================================

choice
    prompt "BLE Sample"

config SAMPLE_SUPPORT_BLE_GATT_CLIENT_SAMPLE
    bool "Support BLE GATT Client Sample."

config SAMPLE_SUPPORT_BLE_GATT_SERVER_SAMPLE
    bool "Support BLE GATT Server Sample."

config SAMPLE_SUPPORT_BLE_SPEED_SERVER_SAMPLE
    bool "Support BLE Throughput Server Sample."

menu "BLE speed server sample configuration"
    depends on SAMPLE_SUPPORT_BLE_SPEED_SERVER_SAMPLE
config SPEED_DEFAULT_CONN_INTERVAL
    int "Set default connection interval (1 slot = 1.25ms)."
    default 10
config PKT_DATA_LEN
    int "Set packet data length."
    default 244
config PHY
    int "Set PHY (1:1M, 1:2M)."
    default 1
config MAX_TX_POWER_LEVEL
    int "Set max tx power level (nv: 0x20A0)."
    default 3
endmenu

config SAMPLE_SUPPORT_BLE_SPEED_CLIENT_SAMPLE
    bool "Support BLE Throughput Client Sample"

config SAMPLE_SUPPORT_BLE_CFG_SAMPLE
    bool "Support BLE WIFI CFG Sample"

endchoice
```

## sle/Kconfig
```kconfig
#===============================================================================
# @brief    Kconfig file.
# Copyright (c) HiSilicon (Shanghai) Technologies Co., Ltd. 2023-2023. All rights reserved.
#===============================================================================

choice
    prompt "SLE Sample"

config SAMPLE_SUPPORT_SLE_UUID_SERVER_SAMPLE
    bool "Support SLE UUID Server Sample."

config SAMPLE_SUPPORT_SLE_UUID_CLIENT_SAMPLE
    bool "Support SLE UUID Client Sample."

config SAMPLE_SUPPORT_SLE_SPEED_SERVER_SAMPLE
    bool "Support SLE Throughput Server Sample."

menu "SLE speed server sample configuration"
    depends on SAMPLE_SUPPORT_SLE_SPEED_SERVER_SAMPLE
config LARGE_THROUGHPUT_SERVER
    bool "server large throughput."
    default y
config SPEED_DEFAULT_CONN_INTERVAL
    int "Set default connection interval."
    default 20
config PKT_DATA_LEN
    int "Set packet data length."
    default 1370
config FRAME_FORMAT
    int "Set frame format (0:SLE_RADIO_FRAME_1, 1:SLE_RADIO_FRAME_2)."
    default 1
config PHY
    int "Set PHY (0:SLE_PHY_1M, 1:SLE_PHY_2M, 2:SLE_PHY_4M)."
    default 2
config MCS
    int "Set MCS."
    default 6
config MAX_TX_POWER_LEVEL
    int "Set max tx power level (nv: 0x20A0)."
    default 7
config SEND_DELAY_MS
    int "Set send delay ms."
    default 0

config SLE_MAC_ADDR_1ST_BYTE
    hex "Set MAC address 1st byte."
    default 0x11
config SLE_MAC_ADDR_2ND_BYTE
    hex "Set MAC address 2nd byte."
    default 0x22
config SLE_MAC_ADDR_3RD_BYTE
    hex "Set MAC address 3rd byte."
    default 0x33
config SLE_MAC_ADDR_4TH_BYTE
    hex "Set MAC address 4th byte."
    default 0x44
config SLE_MAC_ADDR_5TH_BYTE
    hex "Set MAC address 5th byte."
    default 0x55
config SLE_MAC_ADDR_6TH_BYTE
    hex "Set MAC address 6th byte."
    default 0x66
endmenu

config SAMPLE_SUPPORT_SLE_SPEED_CLIENT_SAMPLE
    bool "Support SLE Throughput Client Sample."
menu "SLE speed client sample configuration"
    depends on SAMPLE_SUPPORT_SLE_SPEED_CLIENT_SAMPLE
config LARGE_THROUGHPUT_CLIENT
    bool "client large throughput."
    default y
config RECV_PKT_CNT
    int "Set receive packet count."
    default 1000
config SCANNED_SLE_MAC_ADDR_1ST_BYTE
    hex "Set Scanned MAC address 1st byte."
    default 0x11
config SCANNED_SLE_MAC_ADDR_2ND_BYTE
    hex "Set Scanned MAC address 2nd byte."
    default 0x22
config SCANNED_SLE_MAC_ADDR_3RD_BYTE
    hex "Set Scanned MAC address 3rd byte."
    default 0x33
config SCANNED_SLE_MAC_ADDR_4TH_BYTE
    hex "Set Scanned MAC address 4th byte."
    default 0x44
config SCANNED_SLE_MAC_ADDR_5TH_BYTE
    hex "Set Scanned MAC address 5th byte."
    default 0x55
config SCANNED_SLE_MAC_ADDR_6TH_BYTE
    hex "Set Scanned MAC address 6th byte."
    default 0x66
endmenu

config SAMPLE_SLE_LATENCY_CLIENT_SAMPLE
    bool "Support SLE Latency Client Sample."

config SAMPLE_SLE_LATENCY_SERVER_SAMPLE
    bool "Support SLE Latency Server Sample."

config SAMPLE_SLE_LATENCY_GPIO_OBSERVER_SAMPLE
    bool "Support SLE Latency GPIO Observer."

config SAMPLE_SLE_DD_CLIENT_SAMPLE
    bool "Support SLE Device Discovery (DD) Client Sample."
menu "SLE DD client sample configuration"
    depends on SAMPLE_SLE_DD_CLIENT_SAMPLE
config TEST_COUNT
    int "Set the default test count value"
    default 1000
config TEST_SCAN_INTERVAL
    int "Set the default scan interval value"
    default 192 # 192*0.125ms = 24ms
config TEST_SCAN_WINDOW
    int "Set the default scan window value"
    default 192 # 192*0.125ms = 24ms
endmenu

config SAMPLE_SLE_DD_SERVER_SAMPLE
    bool "Support SLE Device Discovery (DD) Server Sample."
menu "SLE DD server sample configuration"
    depends on SAMPLE_SLE_DD_SERVER_SAMPLE
config TEST_ADV_INTERVAL
    int "Set the default advertising interval max value"
    default 32 # 32*0.125ms = 4ms
endmenu

config SAMPLE_SLE_CE_CLIENT_SAMPLE
    bool "Support SLE Connection Establishment (CE) Client Sample."
menu "SLE CE client sample configuration"
    depends on SAMPLE_SLE_CE_CLIENT_SAMPLE
config TEST_COUNT
    int "Set the default test count value"
    default 200
config TEST_SCAN_INTERVAL
    int "Set the default scan interval value"
    default 192 # 192*0.125ms = 24ms
config TEST_SCAN_WINDOW
    int "Set the default scan window value"
    default 192 # 192*0.125ms = 24ms
endmenu

config SAMPLE_SLE_CE_SERVER_SAMPLE
    bool "Support SLE Connection Establishment (CE) Server Sample."
menu "SLE CE server sample configuration"
    depends on SAMPLE_SLE_CE_SERVER_SAMPLE
config TEST_ADV_INTERVAL
    int "Set the default advertising interval max value"
    default 32 # 32*0.125ms = 4ms
endmenu

config SAMPLE_SUPPORT_SLE_SPEED_CLIENT_1_VS_N_SAMPLE
    bool "Support SLE Throughput Client 1 vs N Sample."
menu "SLE speed client 1 vs N sample configuration"
    depends on SAMPLE_SUPPORT_SLE_SPEED_CLIENT_1_VS_N_SAMPLE
    config NUM_OF_SERVERS
        int "Set the number of servers (2 <= n <= 6)."
        default 2
endmenu
endchoice
```
